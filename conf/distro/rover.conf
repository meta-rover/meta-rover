## conf/distro/rover.conf
```bitbake
# Distro Layer configuration
# include and overwrite default poky-agl distro
include conf/distro/kuksa.conf
DISTRO = "rover"
DISTRO_NAME = "AGL Rover"
DISTRO_VERSION = "0.1.0"
DISTRO_CODENAME = "arp"
#SDK_VENDOR = "-appstacle-sdk"
SDK_VERSION="${DISTRO_VERSION}"
MAINTAINER = "pedro.cuadrachamorro@fh-dortmund.de"

TARGET_VENDOR = "-rover"

# Override these in poky based distros
ROVER_DEFAULT_DISTRO_FEATURES = "wiringPi"
ROVER_DEFAULT_EXTRA_RDEPENDS = ""
ROVER_DEFAULT_EXTRA_RRECOMMENDS = ""

DISTRO_EXTRA_RDEPENDS += " ${ROVER_DEFAULT_EXTRA_RDEPENDS}"
DISTRO_EXTRA_RRECOMMENDS += " ${ROVER_DEFAULT_EXTRA_RRECOMMENDS}"

DISTRO_FEATURES ?= "${ROVER_DEFAULT_DISTRO_FEATURES} ${DISTRO_FEATURES_LIBC} "
```

## conf/layer.conf
```bitbake
# We have a conf and classes directory, add to BBPATH
BBPATH .= ":${LAYERDIR}"

# We have recipes-* directories, add to BBFILES
BBFILES += "${LAYERDIR}/recipes-*/*/*.bb \
	${LAYERDIR}/recipes-*/*/*.bbappend"

BBFILE_COLLECTIONS += "rover"
BBFILE_PATTERN_rover = "^${LAYERDIR}/"
BBFILE_PRIORITY_rover = "12"

# Add the packages to the image
IMAGE_INSTALL_append = " \
 	rover-menu-service \
 	rover-buttons-service \
 	rover-buzzer-service \
 	rover-config-service \
 	rover-dht22-service \
 	rover-display-service \
 	rover-driving-service \
 	rover-grooveultrasonicsensor-service \
 	rover-gy521-service \
 	rover-hcsr04ultrasonicsensor-service \
 	rover-hmc5883l-service \
 	rover-infraredsensor-service \
 	rover-qmc5883l-service \
 	rover-utils-service \
	rover-app \
	mjpg-streamer \
	opencv \
	raspicam"

PREFERRED_VERSION_nodejs = "8.9.0"
PREFERRED_VERSION_glog = "0.3.4"

# Add the libraries to the sdk
TOOLCHAIN_TARGET_TASK_append = " \
	af-binder-dev \
	wiringpi-dev \
	jsoncpp-dev \
	i2c-tools-dev \
	opencv-dev \
	bluez5 \
	paho-mqtt-c-dev \
	rover-app-dev \
	raspicam-dev \
        libssp \
        libssp-dev"
```
